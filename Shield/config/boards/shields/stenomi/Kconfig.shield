## Shield/config/boards/shields/stenomi/Kconfig.shield
```kconfig
# Copyright (c) 2020 The ZMK Contributors
# SPDX-License-Identifier: MIT

config SHIELD_STENOMI_LEFT
	def_bool $(shields_list_contains,stenomi_left)

config SHIELD_STENOMI_RIGHT
	def_bool $(shields_list_contains,stenomi_right)
```

## Shield/config/west.yml
```yaml
manifest:
  remotes:
    - name: dnaq
      url-base: https://github.com/dnaq
  projects:
    - name: zmk
      remote: dnaq
      revision: plover-hid-hog-attempt
      import: app/west.yml
  self:
    path: config
```

## StenoMi/Shield/config/boards/shields/stenomi/Kconfig.defconfig
```kconfig
# Copyright (c) 2020 The ZMK Contributors
# SPDX-License-Identifier: MIT

if SHIELD_STENOMI_LEFT

config ZMK_KEYBOARD_NAME
	default "StenoMi"

config ZMK_SPLIT_BLE_ROLE_CENTRAL
	default y

endif

if SHIELD_STENOMI_LEFT || SHIELD_STENOMI_RIGHT

config ZMK_SPLIT
	default y

endif
```
